## ext/Config.in
```kconfig
source "$BR2_EXTERNAL_CUSTOMBOARD_PATH/package/lvgl/Config.in"
source "$BR2_EXTERNAL_CUSTOMBOARD_PATH/package/lvgl-app/Config.in"
```

## ext/package/ext-python-lxml/Config.in
```kconfig
config BR2_PACKAGE_EXT_PYTHON_LXML
	bool "python-lxml"
	select BR2_PACKAGE_LIBXML2
	select BR2_PACKAGE_LIBXSLT
	select BR2_PACKAGE_PYTHON3_ZLIB
	help
		Python library for XML processing combining libxml2 and libxslt. Version 6.0.2.
```

## ext/package/lvgl-app/Config.in
```kconfig
config BR2_PACKAGE_LVGL_APP
	select BR2_PACKAGE_LVGL
	bool "lvgl-app"
	help
		Simple LVGL application which uses LVGL and Linux framebuffer.
```
